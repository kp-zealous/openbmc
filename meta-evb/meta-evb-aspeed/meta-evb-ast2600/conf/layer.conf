## meta-evb/meta-evb-aspeed/meta-evb-ast2600/conf/layer.conf
```bitbake
# We have a conf and classes directory, add to BBPATH
BBPATH .= ":${LAYERDIR}"

# We have recipes-* directories, add to BBFILES
BBFILES += "${LAYERDIR}/recipes-*/*/*.bb \
            ${LAYERDIR}/recipes-*/*/*.bbappend"

BBFILE_COLLECTIONS += "meta-evb-ast2600"
BBFILE_PATTERN_meta-evb-ast2600 = "^${LAYERDIR}/"

IMAGE_INSTALL:append = " ntp ptpd"

LAYERSERIES_COMPAT_meta-evb-ast2600 = "langdale mickledore"
```
